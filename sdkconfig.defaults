## sdkconfig.defaults
```kconfig
# ESP32-S3 Default Configuration
# This file contains the default sdkconfig settings for the ESP32-S3-DevKitC-1

# Flash size configuration (8MB)
CONFIG_ESPTOOLPY_FLASHSIZE_8MB=y
CONFIG_ESPTOOLPY_FLASHSIZE="8MB"

# Partition table
CONFIG_PARTITION_TABLE_SINGLE_APP=y

# Serial flasher config
CONFIG_ESPTOOLPY_FLASHMODE_QIO=y
CONFIG_ESPTOOLPY_FLASHFREQ_80M=y

# Compiler options
CONFIG_COMPILER_OPTIMIZATION_SIZE=y

# ESP32S3-Specific
CONFIG_ESP_DEFAULT_CPU_FREQ_240=y
CONFIG_ESP_DEFAULT_CPU_FREQ_MHZ=240

# Console configuration - UART primary (compatible with most setups)
CONFIG_ESP_CONSOLE_UART_DEFAULT=y
CONFIG_ESP_CONSOLE_UART_NUM=0
CONFIG_ESP_CONSOLE_UART_BAUDRATE=115200

# FreeRTOS
CONFIG_FREERTOS_HZ=1000

# Log output
CONFIG_LOG_DEFAULT_LEVEL_INFO=y
CONFIG_LOG_MAXIMUM_LEVEL_INFO=y
```
